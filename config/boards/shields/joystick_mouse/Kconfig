## config/boards/shields/joystick_mouse/Kconfig
```kconfig
if SHIELD_JOYSTICK_MOUSE

config ZMK_KEYBOARD_NAME
    default "JoystickMouse"

endif
```

## config/boards/shields/joystick_mouse/Kconfig.shield
```kconfig
config SHIELD_JOYSTICK_MOUSE
    def_bool $(shields_list_contains,joystick_mouse)
```

## config/west.yml
```yaml
manifest:
  remotes:
    - name: zmkfirmware
      url-base: https://github.com/zmkfirmware
    - name: petejohanson
      url-base: https://github.com/petejohanson
  projects:
    - name: zmk
      remote: petejohanson
      revision: feat/pointers-rebased-v4.0
      import: app/west.yml
  self:
    path: config
```
