/ {
    chosen {
        zmk,kscan = &kscan0;
    };

    kscan0: kscan_0 {
        compatible = "zmk,kscan-gpio-direct";
        input-gpios
            = <&gpio0 6 (GPIO_ACTIVE_LOW | GPIO_PULL_UP)>; // P0.06 (nice!nanoの7番ピン付近)
    };
};